## board/freescale/imx8mn_iwg37m/Kconfig
```kconfig
if TARGET_IMX8MN_IWG37M

config SYS_BOARD
	default "imx8mn_iwg37m"

config SYS_VENDOR
	default "freescale"

config SYS_CONFIG_NAME
	default "imx8mn_iwg37m"

config IMX8MN_FORCE_NOM_SOC
	bool "Force to use nominal mode for SOC and ARM"
	default n

source "board/freescale/common/Kconfig"

endif
```
